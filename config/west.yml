## config/west.yml
```yaml
manifest:
  remotes:
    - name: zmkfirmware
      url-base: https://github.com/zmkfirmware
    - name: analog-driver
      url-base: https://github.com/humble-biz-man
  projects:
    - name: zmk
      remote: zmkfirmware
      revision: main
      import: app/west.yml
    - name: zmk-analog-input-driver
      remote: analog-driver
      revision: main
  self:
    path: config
```
